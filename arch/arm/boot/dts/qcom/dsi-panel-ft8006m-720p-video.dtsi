/* Copyright (c) 2013-2015, The Linux Foundation. All rights reserved.
 *
 * This program is free software; you can redistribute it and/or modify
 * it under the terms of the GNU General Public License version 2 and
 * only version 2 as published by the Free Software Foundation.
 *
 * This program is distributed in the hope that it will be useful,
 * but WITHOUT ANY WARRANTY; without even the implied warranty of
 * MERCHANTABILITY or FITNESS FOR A PARTICULAR PURPOSE.  See the
 * GNU General Public License for more details.
 */

&mdss_mdp {
	dsi_ft8006m_720_vid: qcom,mdss_dsi_ft8006m_720p_video {
		qcom,mdss-dsi-panel-name = "ft8006m 720p video mode dsi panel";
		qcom,mdss-dsi-panel-type = "dsi_video_mode";
		qcom,mdss-dsi-panel-framerate = <60>;
		qcom,mdss-dsi-virtual-channel-id = <0>;
		qcom,mdss-dsi-stream = <0>;
		qcom,mdss-dsi-panel-width = <720>;
		qcom,mdss-dsi-panel-height = <1440>;
		qcom,mdss-dsi-h-front-porch = <240>;
		qcom,mdss-dsi-h-back-porch = <150>;
		qcom,mdss-dsi-h-pulse-width = <14>;
		qcom,mdss-dsi-h-sync-skew = <0>;
		qcom,mdss-dsi-v-back-porch = <37>;
		qcom,mdss-dsi-v-front-porch = <190>;
		qcom,mdss-dsi-v-pulse-width = <8>;
		qcom,mdss-dsi-h-left-border = <0>;
		qcom,mdss-dsi-h-right-border = <0>;
		qcom,mdss-dsi-v-top-border = <0>;
		qcom,mdss-dsi-v-bottom-border = <0>;
		qcom,mdss-dsi-bpp = <24>;
		qcom,mdss-dsi-underflow-color = <0xff>;
		qcom,mdss-dsi-border-color = <0>;
        qcom,ulps-enabled;
                qcom,cont-splash-enabled;
		qcom,mdss-dsi-lp11-init;
		qcom,mdss-dsi-post-init-delay = <1>;		
		qcom,mdss-dsi-hfp-power-mode;
	qcom,mdss-dsi-on-command = [
	                                  
        05 01 00 00 78 00 02 11 00
        39 01 00 00 00 00 03 50 5A 0E
        39 01 00 00 00 00 04 83 AC B4 6D
        39 01 00 00 00 00 03 50 5A 23
        39 01 00 00 00 00 07 90 00 00 00 00 2c 00
        39 01 00 00 00 00 03 50 5A 19
        39 01 00 00 00 00 02 8F 0F
        39 01 00 00 00 00 07 90 F0 6F F6 EF 7F AF
        39 01 00 00 00 00 04 A0 00 2F 32
        05 01 00 00 0A 00 02 29 00
		

];

		qcom,mdss-dsi-off-command = [		
		05 01 00 00 14 00 02 28 00
		05 01 00 00 78 00 02 10 00
		39 01 00 00 00 00 02 04 5A 
        	39 01 00 00 FF 00 02 05 5A
];

		qcom,mdss-dsi-on-command-state = "dsi_lp_mode";
		qcom,mdss-dsi-off-command-state = "dsi_lp_mode";
		qcom,mdss-dsi-h-sync-pulse = <1>;
		qcom,mdss-dsi-traffic-mode = "burst_mode";
		qcom,mdss-dsi-bllp-eof-power-mode;
		qcom,mdss-dsi-bllp-power-mode;
		qcom,mdss-dsi-lane-0-state;
		qcom,mdss-dsi-lane-1-state;
		qcom,mdss-dsi-lane-2-state;
		qcom,mdss-dsi-lane-3-state; 
		qcom,mdss-dsi-panel-timings = [b9 2a 1c 00 54 58 22 2e 23 03 04 00];
		qcom,mdss-dsi-t-clk-post = <0x03>;
		qcom,mdss-dsi-t-clk-pre = <0x24>;
		qcom,mdss-dsi-bl-min-level = <3>;
		qcom,mdss-dsi-bl-max-level = <4095>;  
		qcom,mdss-dsi-dma-trigger = "trigger_sw";
		qcom,mdss-dsi-mdp-trigger = "none";
		qcom,mdss-dsi-bl-pmic-control-type = "bl_ctrl_dcs";
		qcom,mdss-dsi-reset-sequence = <1 20>, <0 1>, <1 20>;  
		//qcom,mdss-pan-physical-width-dimension = <59>;
		//qcom,mdss-pan-physical-height-dimension = <104>;
		qcom,panel-supply-entries = <&dsi_panel_pwr_supply_ft8006m>;

	};
};
