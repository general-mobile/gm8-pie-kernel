/* Copyright (c) 2013-2015, The Linux Foundation. All rights reserved.
 *
 * This program is free software; you can redistribute it and/or modify
 * it under the terms of the GNU General Public License version 2 and
 * only version 2 as published by the Free Software Foundation.
 *
 * This program is distributed in the hope that it will be useful,
 * but WITHOUT ANY WARRANTY; without even the implied warranty of
 * MERCHANTABILITY or FITNESS FOR A PARTICULAR PURPOSE.  See the
 * GNU General Public License for more details.
 */

&mdss_mdp {
	dsi_hx83102b_720_vid: qcom,mdss_dsi_hx83102b_720p_video {
		qcom,mdss-dsi-panel-name = "hx83102b 720p video mode dsi panel";
		qcom,mdss-dsi-panel-type = "dsi_video_mode";
		qcom,mdss-dsi-panel-framerate = <60>;
		qcom,mdss-dsi-virtual-channel-id = <0>;
		qcom,mdss-dsi-stream = <0>;
		qcom,mdss-dsi-panel-width = <720>;
		qcom,mdss-dsi-panel-height = <1440>;
		qcom,mdss-dsi-h-front-porch = <200>;
		qcom,mdss-dsi-h-back-porch = <40>;
		qcom,mdss-dsi-h-pulse-width = <10>;
		qcom,mdss-dsi-h-sync-skew = <0>;
		qcom,mdss-dsi-v-back-porch = <16>;
		qcom,mdss-dsi-v-front-porch = <200>;
		qcom,mdss-dsi-v-pulse-width = <2>;
		qcom,mdss-dsi-h-left-border = <0>;
		qcom,mdss-dsi-h-right-border = <0>;
		qcom,mdss-dsi-v-top-border = <0>;
		qcom,mdss-dsi-v-bottom-border = <0>;
		qcom,mdss-dsi-bpp = <24>;
		qcom,mdss-dsi-underflow-color = <0xff>;
		qcom,mdss-dsi-border-color = <0>;
        qcom,ulps-enabled;
                qcom,cont-splash-enabled;
/*
		qcom,mdss-dsi-on-command = [05 01 00 00 c8 00 02 11 00
				39 01 00 00 00 00 03 51 0F FF
				39 01 00 00 00 00 02 53 2c
				39 01 00 00 00 00 02 55 01								
				05 01 00 00 c8 00 02 29 00];

*/

	qcom,mdss-dsi-on-command = [39 01 00 00 00 00 04 B9 83 10 2B
				39 01 00 00 00 00 04 C9 04 0B B8
				05 01 00 00 78 00 02 11 00
				39 01 00 00 00 00 03 51 00 00
				39 01 00 00 00 00 02 53 2c
				39 01 00 00 00 00 02 55 00							
				05 01 00 00 14 00 02 29 00			

];

		qcom,mdss-dsi-off-command = [05 01 00 00 3c 00 02 28 00
				05 01 00 00 16 00 02 10 00];
		qcom,mdss-dsi-on-command-state = "dsi_lp_mode";   //dsi_lp_mode
		qcom,mdss-dsi-off-command-state = "dsi_lp_mode";
		qcom,mdss-dsi-h-sync-pulse = <1>;
		qcom,mdss-dsi-traffic-mode = "burst_mode";  
		qcom,mdss-dsi-hfp-power-mode;
		 qcom,esd-check-enabled;
		 
		qcom,mdss-dsi-panel-status-command = [06 01 00 01 05 00 01 0A
			06 01 00 01 05 00 01 09
			06 01 00 01 05 00 01 b1];
			//06 01 00 01 05 00 01 45];
		qcom,mdss-dsi-panel-status-command-state = "dsi_lp_mode";
		qcom,mdss-dsi-panel-status-check-mode = "reg_read";
		qcom,mdss-dsi-panel-status-read-length = <4 4 4>;   // 1
		qcom,mdss-dsi-panel-max-error-count = <3>;
		qcom,mdss-dsi-panel-status-valid-params = <1 3 2>;
		qcom,mdss-dsi-panel-status-value =<0x9D 0x80 0x73 0x04  0x04 0x2a>;
		//qcom,mdss-dsi-panel-status-value =<0x9D 0x80 0x73 0x04  0x04 0x2a 0x27 0x27>;
	//		qcom,mdss-dsi-panel-status-value =<0x9D 0x80 0x73 0x04 0x05 0xB1>;  //9c  04 2a 35 35
		//qcom,mdss-dsi-panel-status-value =<0x9D 0x80 0x73 0x04>;
		//qcom,mdss-dsi-panel-status-value = <0x9d>;   //9d  ok
	
		qcom,mdss-dsi-lp11-init;
		qcom,mdss-dsi-bllp-eof-power-mode;
		qcom,mdss-dsi-bllp-power-mode;   
		qcom,mdss-dsi-lane-0-state;
		qcom,mdss-dsi-lane-1-state;
		qcom,mdss-dsi-lane-2-state;
		qcom,mdss-dsi-lane-3-state;
		qcom,mdss-dsi-panel-timings =   [a4 24 18 00 4c 50 1c 28 1c 03 04 00];
		qcom,mdss-dsi-t-clk-post = <0x04>;
		qcom,mdss-dsi-t-clk-pre = <0x20>;
		//qcom,mdss-dsi-t-clk-pre = <0x1D>;
		qcom,mdss-dsi-bl-min-level = <3>;
		qcom,mdss-dsi-bl-max-level = <4095>;  //4095
		qcom,mdss-dsi-dma-trigger = "trigger_sw";
		qcom,mdss-dsi-mdp-trigger = "none";
		/* qcom,mdss-dsi-bl-pmic-control-type = "bl_ctrl_wled"; */
		qcom,mdss-dsi-bl-pmic-control-type = "bl_ctrl_dcs";
		qcom,mdss-dsi-reset-sequence = <1 20>, <0 10>, <1 60>;   //1
		//qcom,mdss-pan-physical-width-dimension = <59>;
		//qcom,mdss-pan-physical-height-dimension = <104>;

	};
};


