## drivers/input/fingerprint/fpc_gm/Kconfig
```kconfig
config FINGERPRINT_FPC1020_GM
    tristate "fpc fingerprint "
    help 
        say y enable fpc
```

## drivers/input/fingerprint/sunwave/Kconfig
```kconfig
#
# Input device configuration
#

menu "Fingerprint device support"

config FINGERPRINT_SUNWAVE_FINGER
	tristate "SUNWAVE_FINGER fingerprint drvier support"
	help
	  Say Y here to enable SUNWAVE_FINGER fingerprint driver support!
	  
endmenu
```

## drivers/input/touchscreen/hxchipset/Kconfig
```kconfig
#
# Himax Touchscreen driver configuration
#

config TOUCHSCREEN_HIMAX_I2C
        bool "touchscreen himax i2c"
        default y
		help
		This enables support for HIMAX CHIPSET over I2C based touchscreens.

config TOUCHSCREEN_HIMAX_DEBUG
        tristate "HIMAX debug function"
		depends on TOUCHSCREEN_HIMAX_I2C
		help
		This enables support for HIMAX debug function.

config TOUCHSCREEN_HIMAX_ITO_TEST
	tristate "HIMAX driver test over Dragon Board"
	depends on TOUCHSCREEN_HIMAX_I2C
	help
	  This enables support for HIMAX driver test over Dragon Board.

config HMX_DB
	tristate "HIMAX driver test over Dragon Board"
	depends on TOUCHSCREEN_HIMAX_I2C
	help
	  This enables support for HIMAX driver test over Dragon Board.
```
